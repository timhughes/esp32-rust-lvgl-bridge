## components/esp_lvgl_bridge/Kconfig
```kconfig
menu "ESP LVGL Bridge Configuration"

    config LVGL_BRIDGE_CMD_QUEUE_DEPTH
        int "UI Command Queue Depth"
        default 128
        help
            Maximum depth of FreeRTOS queue passing user interaction events
            (touch, button, slider) from LVGL UI to the Rust worker.

    config LVGL_BRIDGE_TELEM_QUEUE_DEPTH
        int "Device Telemetry Queue Depth"
        default 256
        help
            Maximum depth of FreeRTOS queue passing status and telemetry updates
            from the Rust domain worker to the LVGL scene graph.

    config LVGL_BRIDGE_ARBITRATION_HOLDOFF_MS
        int "Arbitration Holdoff Duration (ms)"
        default 500
        help
            Duration in milliseconds that incoming device telemetry is suppressed
            after touch release to prevent UI control jitter.

    config LVGL_BRIDGE_INACTIVITY_TIMEOUT_SEC
        int "Screen Inactivity Blanking Timeout (seconds)"
        default 60
        help
            Inactivity duration in seconds before blanking the display backlight.
            Set to 0 to disable automatic blanking.

endmenu
```

## sdkconfig.defaults.esp32s3
```kconfig
# Target Selection
CONFIG_IDF_TARGET="esp32s3"

# System Clock
CONFIG_ESP_DEFAULT_CPU_FREQ_MHZ_240=y
CONFIG_ESP_DEFAULT_CPU_FREQ_MHZ=240

# Flash: 16MB QIO 80MHz
CONFIG_ESPTOOLPY_FLASHSIZE_16MB=y
CONFIG_ESPTOOLPY_FLASHSIZE="16MB"
CONFIG_ESPTOOLPY_FLASHMODE_QIO=y
CONFIG_ESPTOOLPY_FLASHFREQ_80M=y

# PSRAM: 8MB Octal SPI 80MHz
CONFIG_SPIRAM=y
CONFIG_SPIRAM_MODE_OCT=y
CONFIG_SPIRAM_SPEED_80M=y
CONFIG_SPIRAM_BOOT_INIT=y
CONFIG_SPIRAM_USE_MALLOC=y
CONFIG_SPIRAM_MEMTEST=y
CONFIG_SPIRAM_TRY_ALLOCATE_WIFI_LWIP=y

# FreeRTOS 1000Hz tick rate
CONFIG_FREERTOS_HZ=1000

# Main Task Stack Size
CONFIG_ESP_MAIN_TASK_STACK_SIZE=8192

# LVGL Configuration
CONFIG_LV_COLOR_DEPTH_16=y
CONFIG_LV_COLOR_16_SWAP=y
```
